## package/postgresql/Config.in
```kconfig
config BR2_PACKAGE_POSTGRESQL
	bool "postgresql"
	depends on BR2_USE_MMU # fork()
	# fails to build in a pure static linking scenario, and
	# postgresql is unlikely to be used in a pure statically
	# linked environment.
	depends on !BR2_STATIC_LIBS
	select BR2_PACKAGE_POSTGRESQL_CLIENT if !BR2_PACKAGE_POSTGRESQL_SERVER
	help
	  PostgreSQL is a powerful, open source object-relational
	  database system.

	  Enable the readline package to gain readline support in
	  pgsql (the command line interpreter), which offers
	  command history and edit functions.

	  Enable the zlib package to gain builtin compression for
	  archives with pg_dump and pg_restore.

	  http://www.postgresql.org

if BR2_PACKAGE_POSTGRESQL

config BR2_PACKAGE_POSTGRESQL_CLIENT
	bool "PostgreSQL client libraries"
	default y
	help
	  Install the PostgreSQL client libraries on the target.

config BR2_PACKAGE_POSTGRESQL_SERVER
	bool "PostgreSQL server"
	default y
	help
	  Install the PostgreSQL server on the target.

endif

comment "postgresql needs a toolchain w/ dynamic library"
	depends on BR2_STATIC_LIBS
```
